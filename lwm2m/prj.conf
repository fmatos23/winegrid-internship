## Kconfig
```
# Private config options for LwM2M client sample

# Copyright (c) 2023 NordicNordic Semiconductor ASA
# SPDX-License-Identifier: Apache-2.0

mainmenu "LwM2M Client sample"

config LWM2M_APP_ID
	string "LwM2M Client identity"
	default ""
	help
	  This is used as client endpoint name as well as PSK ID.
	  Leave empty for using CONFIG_BOARD

if LWM2M_DTLS_SUPPORT
config LWM2M_APP_PSK
	string "PSK key"
	default "000102030405060708090a0b0c0d0e0f"
	help
	  PSK key as a hex string.
	  Maximum binary size is CONFIG_LWM2M_SECURITY_KEY_SIZE.

config LWM2M_APP_TLS_TAG
	int "TLS security tag"
	default 1
	help
	  TLS security tag to use when connecting.
endif

if WIFI
config APP_WIFI_SSID
	string "Wi-Fi SSID to auto-connect to at boot"
	default ""
	help
	  If set, main() issues a WIFI_CONNECT request automatically on startup
	  instead of requiring the "wifi connect" shell command after every
	  reset. Baked into the firmware image - this is a PoC convenience,
	  not a secure credential storage mechanism (see notas_estagio.md).

config APP_WIFI_PSK
	string "Wi-Fi password (WPA2-PSK) for APP_WIFI_SSID"
	default ""
endif # WIFI

config LWM2M_APP_SERVER
	string "LwM2M server address"
	default "coap://192.0.2.2:5683" if !LWM2M_DTLS_SUPPORT
	default "coaps://192.0.2.2:5684" if (LWM2M_DTLS_SUPPORT && !LWM2M_RD_CLIENT_SUPPORT_BOOTSTRAP)
	default "coaps://192.0.2.2:5784" if (LWM2M_DTLS_SUPPORT && LWM2M_RD_CLIENT_SUPPORT_BOOTSTRAP)
	help
	  LwM2M server address. Write as a full URI including optional port number.
	  Only accepted protocols are "coap://" and "coaps://"
	  When DNS resolver is enabled, DNS domain names could be used as well.
	  When port number is missing, CONFIG_LWM2M_PEER_PORT is used instead.
	  IPv6 addresses must be enclosed in square brackets, for example "coap://[fd00::1]".

source "Kconfig.zephyr"
```

## prj.conf
```kconfig
CONFIG_NETWORKING=y
CONFIG_LOG=y
CONFIG_GPIO=y
CONFIG_LWM2M_LOG_LEVEL_DBG=y
CONFIG_TEST_RANDOM_GENERATOR=y
CONFIG_NET_IPV6=y
CONFIG_NET_IF_UNICAST_IPV6_ADDR_COUNT=3
CONFIG_NET_IF_MCAST_IPV6_ADDR_COUNT=3
CONFIG_NET_IPV4=y
CONFIG_NET_DHCPV4=n
CONFIG_NET_IF_UNICAST_IPV4_ADDR_COUNT=3
CONFIG_NET_IF_MCAST_IPV4_ADDR_COUNT=2
CONFIG_PRINTK=y
CONFIG_NET_PKT_RX_COUNT=10
CONFIG_NET_PKT_TX_COUNT=10
CONFIG_NET_BUF_RX_COUNT=10
CONFIG_NET_BUF_TX_COUNT=10
CONFIG_NET_MAX_CONTEXTS=5

CONFIG_NET_LOG=y

CONFIG_NET_CONFIG_NEED_IPV6=y
CONFIG_NET_CONFIG_NEED_IPV4=y
CONFIG_NET_CONFIG_SETTINGS=y

CONFIG_LWM2M=y
CONFIG_LWM2M_COAP_BLOCK_SIZE=512
CONFIG_LWM2M_IPSO_SUPPORT=y
CONFIG_LWM2M_IPSO_TEMP_SENSOR=y
CONFIG_LWM2M_IPSO_LIGHT_CONTROL=y
CONFIG_LWM2M_IPSO_TIMER=y
CONFIG_LWM2M_SHELL=y

CONFIG_NET_CONFIG_MY_IPV6_ADDR="2001:db8::1"
CONFIG_NET_CONFIG_PEER_IPV6_ADDR="2001:db8::2"
CONFIG_NET_CONFIG_MY_IPV4_ADDR="192.0.2.1"
CONFIG_NET_CONFIG_MY_IPV4_GW="192.0.2.2"

# Longer endpoint name might be returned in a registration reply
CONFIG_COAP_EXTENDED_OPTIONS_LEN=y
CONFIG_COAP_EXTENDED_OPTIONS_LEN_VALUE=40

# Points at the Leshan server running on the dev laptop's Wi-Fi IP.
# Update this if the laptop's IP changes (check with `ip -4 addr show`).
CONFIG_LWM2M_APP_SERVER="coap://192.168.82.56:5683"
CONFIG_LWM2M_APP_ID="esp32-winegrid"
```

## overlay-ota.conf
```kconfig
# MCUboot support so this app can receive real OTA updates via the LwM2M
# Firmware Update object (5), written through flash_img + boot_request_upgrade
# in firmware_update.c. Same MCUboot already flashed/validated for smp_svr -
# it's board-level, not app-specific, so it doesn't need reflashing.
CONFIG_BOOTLOADER_MCUBOOT=y
CONFIG_FLASH=y
CONFIG_FLASH_MAP=y
CONFIG_STREAM_FLASH=y
CONFIG_IMG_MANAGER=y
CONFIG_MCUBOOT_IMG_MANAGER=y
CONFIG_REBOOT=y

# firmware_block_received_cb() calls flash_img_buffered_write() directly from
# the LwM2M engine's socket-receive thread. The default LWM2M_ENGINE_STACK_SIZE
# (2560B) isn't enough headroom for CoAP parsing + a real flash write call
# chain (stream_flash -> flash driver -> MCUboot bootutil helpers) - caused a
# stack-overflow crash ("illegal instruction" in thread lwm2m-sock-recv)
# partway through the very first firmware upload attempt.
CONFIG_LWM2M_ENGINE_STACK_SIZE=8192
```

## overlay-wifi.conf
```kconfig
# Wi-Fi networking for the ESP32, merged from zephyr/samples/net/wifi.
# This Zephyr version has no persistent Wi-Fi credentials subsystem, so
# main() connects automatically at boot using the SSID/PSK baked in below
# (see wifi_auto_connect() in lwm2m-client.c) instead of requiring the
# "wifi connect" shell command after every reset. The shell is still enabled
# below for manual debugging/override if needed.
CONFIG_WIFI=y
CONFIG_NET_L2_ETHERNET=y
CONFIG_NET_L2_WIFI_SHELL=y
CONFIG_NET_SHELL=y
CONFIG_SHELL=y

# ROOT CAUSE of every "registers before the network is up" bug we hit today:
# this was never enabled. main()'s "if (IS_ENABLED(CONFIG_NET_CONNECTION_MANAGER))"
# block - which waits for L4_CONNECTED before starting LwM2M - was being compiled
# out entirely as dead code, silently, because this was undefined. It's a
# menuconfig, not auto-selected by anything we had on.
CONFIG_NET_CONNECTION_MANAGER=y

# PoC convenience: credentials baked into the firmware image, not securely
# stored. Fine for a dev board on a lab network; revisit before any real
# deployment (see notas_estagio.md). REDACTED for version control - fill in
# locally before building.
CONFIG_APP_WIFI_SSID="CHANGE_ME_SSID"
CONFIG_APP_WIFI_PSK="CHANGE_ME_PASSWORD"

# Let DHCP (from the AP) assign the address instead of the static
# 192.0.2.x test addresses in prj.conf. NET_CONFIG_SETTINGS is what actually
# applies those static addresses regardless of the NEED_IPV4/6 flags, so it
# has to be fully disabled here, not just its sub-options.
CONFIG_NET_CONFIG_SETTINGS=n
CONFIG_NET_DHCPV4=y
CONFIG_ESP32_WIFI_STA_AUTO_DHCPV4=y

# Disable IPv6: the interface gets an IPv6 link-local address (SLAAC) the
# instant it's up, with no DHCP/real network needed. The connection manager
# counts that as "L4 ready" and fires NET_EVENT_L4_CONNECTED way before real
# IPv4 (DHCP) connectivity exists, letting LwM2M start registering against a
# network that isn't actually up yet. We only need IPv4 to reach Leshan, so
# just turn IPv6 off.
CONFIG_NET_IPV6=n

# prj.conf's NET_PKT/NET_BUF counts (10 each) were sized for the qemu/native_sim
# test setup, not real Wi-Fi. A firmware push (Object 5) arrives as ~1330 CoAP
# blocks in a burst, concurrently with periodic LwM2M registration-update
# traffic - the esp32_wifi driver ran out of net buffers trying to receive it
# ("net_pkt: Data buffer allocation failed", "Failed to allocate net buffer"),
# and Leshan eventually gave up and cancelled the write ("500 Request cancelled").
CONFIG_NET_PKT_RX_COUNT=30
CONFIG_NET_PKT_TX_COUNT=30
CONFIG_NET_BUF_RX_COUNT=30
CONFIG_NET_BUF_TX_COUNT=30
```

## src/firmware_update.c
```c
/*
 * Origem: baseado no exemplo oficial do Zephyr
 * (samples/net/lwm2m_client/src/firmware_update.c, ver copyright abaixo),
 * cujo Object 5 (Firmware Update) vinha como placeholder sem ligação real
 * ao MCUboot. A lógica de escrita real na partição secundária
 * (flash_img_init()/flash_img_buffered_write()), o disparo do upgrade
 * (boot_request_upgrade()) e o diagnóstico/correção do bug de OTA foram
 * escritos/reescritos nesta colaboração (Claude).
 *
 * Copyright (c) 2022 Nordic Semiconductor
 *
 * SPDX-License-Identifier: Apache-2.0
 */

#define LOG_MODULE_NAME app_fw_update
#include <zephyr/logging/log.h>
LOG_MODULE_REGISTER(LOG_MODULE_NAME);

#include <zephyr/net/lwm2m.h>
#include <zephyr/dfu/flash_img.h>
#include <zephyr/dfu/mcuboot.h>
#include <zephyr/sys/reboot.h>
#include <zephyr/irq.h>
#include "modules.h"

static uint8_t firmware_buf[64];

/* Array with supported PULL firmware update protocols */
static uint8_t supported_protocol[1];

static struct flash_img_context dfu_ctx;
static bool dfu_started;

static int firmware_update_cb(uint16_t obj_inst_id,
			      uint8_t *args, uint16_t args_len)
{
	int ret;

	LOG_INF("Applying firmware update (%zu bytes written)",
		flash_img_bytes_written(&dfu_ctx));

	if (!dfu_started) {
		LOG_ERR("No firmware image was downloaded");
		lwm2m_set_u8(&LWM2M_OBJ(5, 0, 5), RESULT_UPDATE_FAILED);
		return -EINVAL;
	}

	/* This board's MCUboot build is upgrade-only (no test/revert phase -
	 * confirmed separately with the mcumgr/smp_svr PoC, where a test-boot
	 * request is rejected outright). So request the upgrade as permanent
	 * directly, same as that PoC ended up doing.
	 */
	ret = boot_request_upgrade(BOOT_UPGRADE_PERMANENT);
	dfu_started = false;
	if (ret) {
		LOG_ERR("boot_request_upgrade failed: %d", ret);
		lwm2m_set_u8(&LWM2M_OBJ(5, 0, 5), RESULT_UPDATE_FAILED);
		return ret;
	}

	lwm2m_set_u8(&LWM2M_OBJ(5, 0, 3), STATE_IDLE);
	lwm2m_set_u8(&LWM2M_OBJ(5, 0, 5), RESULT_SUCCESS);

	LOG_INF("Rebooting to apply the new image");
	sys_reboot(SYS_REBOOT_WARM);

	return 0;
}

static void *firmware_get_buf(uint16_t obj_inst_id, uint16_t res_id,
			      uint16_t res_inst_id, size_t *data_len)
{
	*data_len = sizeof(firmware_buf);
	return firmware_buf;
}

static int firmware_block_received_cb(uint16_t obj_inst_id, uint16_t res_id,
				      uint16_t res_inst_id, uint8_t *data,
				      uint16_t data_len, bool last_block,
				      size_t total_size, size_t offset)
{
	int ret;

	if (offset == 0) {
		LOG_INF("Starting firmware download, total size %zu", total_size);
		ret = flash_img_init(&dfu_ctx);
		if (ret) {
			LOG_ERR("flash_img_init failed: %d", ret);
			return ret;
		}
		dfu_started = true;
	}

	/* No irq_lock() workaround needed here: the crash this used to cause
	 * (flash write + Wi-Fi ISR -> illegal instruction) was Zephyr issue
	 * #77952 - esp_intr_noniram_disable() was never being called during
	 * flash ops on 3.7.0, a regression from 3.6. Fixed upstream by PR
	 * #78121 (soc/espressif/esp32/soc.c + hal_espressif bump), applied
	 * locally to this checkout. Verified: full ~680KB image over Wi-Fi,
	 * zero crashes, clean MCUboot permanent swap (see notas_estagio.md).
	 */
	ret = flash_img_buffered_write(&dfu_ctx, data, data_len, last_block);
	if (ret) {
		LOG_ERR("flash_img_buffered_write failed: %d", ret);
		dfu_started = false;
		return -ENOSPC;
	}

	LOG_INF("FIRMWARE: BLOCK RECEIVED: offset:%zd len:%u last_block:%d (%zu bytes written)",
		offset, data_len, last_block, flash_img_bytes_written(&dfu_ctx));

	return 0;
}

static int firmware_cancel_cb(const uint16_t obj_inst_id)
{
	LOG_INF("FIRMWARE: Update canceled");
	dfu_started = false;
	return 0;
}

void init_firmware_update(void)
{
	/* setup data buffer for block-wise transfer */
	lwm2m_register_pre_write_callback(&LWM2M_OBJ(5, 0, 0), firmware_get_buf);
	lwm2m_firmware_set_write_cb(firmware_block_received_cb);

	/* register cancel callback */
	lwm2m_firmware_set_cancel_cb(firmware_cancel_cb);

	/* Register the update trigger regardless of PULL support: this is
	 * push mode (the server writes bytes directly into the PACKAGE
	 * resource via CoAP block-wise transfer), and the "Update" exec
	 * resource (5/0/2) always routes through this callback either way -
	 * the upstream sample only wired it up inside the PULL_SUPPORT
	 * ifdef, which left push-mode updates with no handler at all.
	 */
	lwm2m_firmware_set_update_cb(firmware_update_cb);

	if (IS_ENABLED(CONFIG_LWM2M_FIRMWARE_UPDATE_PULL_SUPPORT)) {
		lwm2m_create_res_inst(&LWM2M_OBJ(5, 0, 8, 0));
		lwm2m_set_res_buf(&LWM2M_OBJ(5, 0, 8, 0), &supported_protocol[0],
					 sizeof(supported_protocol[0]),
					 sizeof(supported_protocol[0]), 0);
	}
}
```

## src/led.c
```c
/*
 * Origem: exemplo oficial do Zephyr (samples/net/lwm2m_client/src/led.c),
 * não modificado nesta colaboração.
 *
 * Copyright (c) 2022 Nordic Semiconductor
 *
 * SPDX-License-Identifier: Apache-2.0
 */

#define LOG_MODULE_NAME app_led

#include <zephyr/logging/log.h>
LOG_MODULE_REGISTER(LOG_MODULE_NAME);

#include "modules.h"

#include <zephyr/drivers/gpio.h>
#include <zephyr/net/lwm2m.h>

#define LIGHT_NAME "Test light"

/* If led0 gpios doesn't exist the relevant IPSO object will simply not be created. */
static const struct gpio_dt_spec led_gpio = GPIO_DT_SPEC_GET_OR(DT_ALIAS(led0), gpios, {});
static uint32_t led_state;

/* TODO: Move to a pre write hook that can handle ret codes once available */
static int led_on_off_cb(uint16_t obj_inst_id, uint16_t res_id, uint16_t res_inst_id, uint8_t *data,
			 uint16_t data_len, bool last_block, size_t total_size, size_t offset)
{
	int ret = 0;
	uint32_t led_val;

	led_val = *(uint8_t *)data;
	if (led_val != led_state) {
		ret = gpio_pin_set_dt(&led_gpio, (int)led_val);
		if (ret) {
			/*
			 * We need an extra hook in LWM2M to better handle
			 * failures before writing the data value and not in
			 * post_write_cb, as there is not much that can be
			 * done here.
			 */
			LOG_ERR("Fail to write to GPIO %d", led_gpio.pin);
			return ret;
		}

		led_state = led_val;
		/* TODO: Move to be set by an internal post write function */
		lwm2m_set_s32(&LWM2M_OBJ(3311, 0, 5852), 0);
	}

	return ret;
}

int init_led_device(void)
{
	int ret;

	if (!gpio_is_ready_dt(&led_gpio)) {
		return -ENODEV;
	}

	ret = gpio_pin_configure_dt(&led_gpio, GPIO_OUTPUT_INACTIVE);
	if (ret) {
		return ret;
	}

	lwm2m_create_object_inst(&LWM2M_OBJ(3311, 0));
	lwm2m_register_post_write_callback(&LWM2M_OBJ(3311, 0, 5850), led_on_off_cb);
	lwm2m_set_res_buf(&LWM2M_OBJ(3311, 0, 5750), LIGHT_NAME, sizeof(LIGHT_NAME),
			  sizeof(LIGHT_NAME), LWM2M_RES_DATA_FLAG_RO);

	return 0;
}
```

## src/lwm2m-client.c
```c
/*
 * Origem: baseado no exemplo oficial do Zephyr
 * (samples/net/lwm2m_client/src/lwm2m-client.c, ver copyright abaixo).
 * A ligação automática a Wi-Fi (wifi_auto_connect() e a integração com o
 * Connection Manager à volta dela) foi acrescentada nesta colaboração
 * (Claude) - o exemplo original não tem suporte a Wi-Fi automático nesta
 * versão do Zephyr. O resto (registo de objetos LwM2M, arranque do
 * cliente) é essencialmente do exemplo original.
 *
 * Copyright (c) 2017 Linaro Limited
 * Copyright (c) 2017-2019 Foundries.io
 *
 * SPDX-License-Identifier: Apache-2.0
 */

#define LOG_MODULE_NAME net_lwm2m_client_app
#define LOG_LEVEL LOG_LEVEL_DBG

#include <zephyr/logging/log.h>
LOG_MODULE_REGISTER(LOG_MODULE_NAME);

#include <zephyr/drivers/hwinfo.h>
#include <zephyr/kernel.h>
#include <zephyr/drivers/gpio.h>
#include <zephyr/drivers/sensor.h>
#include <zephyr/net/lwm2m.h>
#include <zephyr/net/conn_mgr_monitor.h>
#include <zephyr/net/conn_mgr_connectivity.h>
#if defined(CONFIG_WIFI)
#include <zephyr/net/wifi_mgmt.h>
#endif
#include "modules.h"
#include "lwm2m_resource_ids.h"

#define APP_BANNER "Run LWM2M client"

#define WAIT_TIME	K_SECONDS(10)
#define CONNECT_TIME	K_SECONDS(10)

#define CLIENT_MANUFACTURER	"Zephyr"
#define CLIENT_MODEL_NUMBER	"OMA-LWM2M Sample Client"
#define CLIENT_SERIAL_NUMBER	"345000123"
#define CLIENT_FIRMWARE_VER	"1.0"
#define CLIENT_HW_VER		"1.0.1"
#define TEMP_SENSOR_UNITS	"Celcius"

/* Macros used to subscribe to specific Zephyr NET management events. */
#define L4_EVENT_MASK (NET_EVENT_L4_CONNECTED | NET_EVENT_L4_DISCONNECTED)
#define CONN_LAYER_EVENT_MASK (NET_EVENT_CONN_IF_FATAL_ERROR)

static uint8_t bat_idx = LWM2M_DEVICE_PWR_SRC_TYPE_BAT_INT;
static int bat_mv = 3800;
static int bat_ma = 125;
static uint8_t usb_idx = LWM2M_DEVICE_PWR_SRC_TYPE_USB;
static int usb_mv = 5000;
static int usb_ma = 900;
static uint8_t bat_level = 95;
static uint8_t bat_status = LWM2M_DEVICE_BATTERY_STATUS_CHARGING;
static int mem_free = 15;
static int mem_total = 25;
static double min_range = 0.0;
static double max_range = 100;

static struct lwm2m_ctx client_ctx;

static const char *endpoint =
	(sizeof(CONFIG_LWM2M_APP_ID) > 1 ? CONFIG_LWM2M_APP_ID : CONFIG_BOARD);

#if defined(CONFIG_LWM2M_DTLS_SUPPORT)
BUILD_ASSERT(sizeof(endpoint) <= CONFIG_LWM2M_SECURITY_KEY_SIZE,
		"Client ID length is too long");
#endif /* CONFIG_LWM2M_DTLS_SUPPORT */

static struct k_sem quit_lock;

/* Zephyr NET management event callback structures. */
static struct net_mgmt_event_callback l4_cb;
static struct net_mgmt_event_callback conn_cb;

static K_SEM_DEFINE(network_connected_sem, 0, 1);

static int device_reboot_cb(uint16_t obj_inst_id,
			    uint8_t *args, uint16_t args_len)
{
	LOG_INF("DEVICE: REBOOT");
	/* Add an error for testing */
	lwm2m_device_add_err(LWM2M_DEVICE_ERROR_LOW_POWER);
	/* Change the battery voltage for testing */
	lwm2m_set_s32(&LWM2M_OBJ(3, 0, 7, 0), (bat_mv - 1));

	return 0;
}

static int device_factory_default_cb(uint16_t obj_inst_id,
				     uint8_t *args, uint16_t args_len)
{
	LOG_INF("DEVICE: FACTORY DEFAULT");
	/* Add an error for testing */
	lwm2m_device_add_err(LWM2M_DEVICE_ERROR_GPS_FAILURE);
	/* Change the USB current for testing */
	lwm2m_set_s32(&LWM2M_OBJ(3, 0, 8, 1), (usb_ma - 1));

	return 0;
}

static int lwm2m_setup(void)
{
	struct lwm2m_res_item temp_sensor_items[] = {
		{&LWM2M_OBJ(IPSO_OBJECT_TEMP_SENSOR_ID, 0, MIN_RANGE_VALUE_RID), &min_range,
		 sizeof(min_range)},
		{&LWM2M_OBJ(IPSO_OBJECT_TEMP_SENSOR_ID, 0, MAX_RANGE_VALUE_RID), &max_range,
		 sizeof(max_range)},
		{&LWM2M_OBJ(IPSO_OBJECT_TEMP_SENSOR_ID, 0, SENSOR_UNITS_RID), TEMP_SENSOR_UNITS,
		 sizeof(TEMP_SENSOR_UNITS)}
	};

	/* setup SECURITY object */

	/* Server URL */
	lwm2m_set_string(&LWM2M_OBJ(0, 0, 0), CONFIG_LWM2M_APP_SERVER);

	/* Security Mode */
	lwm2m_set_u8(&LWM2M_OBJ(0, 0, 2), IS_ENABLED(CONFIG_LWM2M_DTLS_SUPPORT) ? 0 : 3);
#if defined(CONFIG_LWM2M_DTLS_SUPPORT)
	lwm2m_set_string(&LWM2M_OBJ(0, 0, 3), endpoint);
	if (sizeof(CONFIG_LWM2M_APP_PSK) > 1) {
		char psk[1 + sizeof(CONFIG_LWM2M_APP_PSK) / 2];
		/* Need to skip the nul terminator from string */
		size_t len = hex2bin(CONFIG_LWM2M_APP_PSK, sizeof(CONFIG_LWM2M_APP_PSK) - 1, psk,
				     sizeof(psk));
		if (len <= 0) {
			return -EINVAL;
		}
		lwm2m_set_opaque(&LWM2M_OBJ(0, 0, 5), (void *)psk, len);
	}
#endif /* CONFIG_LWM2M_DTLS_SUPPORT */

#if defined(CONFIG_LWM2M_RD_CLIENT_SUPPORT_BOOTSTRAP)
	/* Mark 1st instance of security object as a bootstrap server */
	lwm2m_set_u8(&LWM2M_OBJ(0, 0, 1), 1);

	/* Create 2nd instance of security object needed for bootstrap */
	lwm2m_create_object_inst(&LWM2M_OBJ(0, 1));
#else
	/* Match Security object instance with a Server object instance with
	 * Short Server ID.
	 */
	lwm2m_set_u16(&LWM2M_OBJ(0, 0, 10), CONFIG_LWM2M_SERVER_DEFAULT_SSID);
	lwm2m_set_u16(&LWM2M_OBJ(1, 0, 0), CONFIG_LWM2M_SERVER_DEFAULT_SSID);
#endif

	/* setup SERVER object */

	/* setup DEVICE object */

	lwm2m_set_res_buf(&LWM2M_OBJ(3, 0, 0), CLIENT_MANUFACTURER, sizeof(CLIENT_MANUFACTURER),
			  sizeof(CLIENT_MANUFACTURER), LWM2M_RES_DATA_FLAG_RO);
	lwm2m_set_res_buf(&LWM2M_OBJ(3, 0, 1), CLIENT_MODEL_NUMBER, sizeof(CLIENT_MODEL_NUMBER),
			  sizeof(CLIENT_MODEL_NUMBER), LWM2M_RES_DATA_FLAG_RO);
	lwm2m_set_res_buf(&LWM2M_OBJ(3, 0, 2), CLIENT_SERIAL_NUMBER, sizeof(CLIENT_SERIAL_NUMBER),
			  sizeof(CLIENT_SERIAL_NUMBER), LWM2M_RES_DATA_FLAG_RO);
	lwm2m_set_res_buf(&LWM2M_OBJ(3, 0, 3), CLIENT_FIRMWARE_VER, sizeof(CLIENT_FIRMWARE_VER),
			  sizeof(CLIENT_FIRMWARE_VER), LWM2M_RES_DATA_FLAG_RO);
	lwm2m_register_exec_callback(&LWM2M_OBJ(3, 0, 4), device_reboot_cb);
	lwm2m_register_exec_callback(&LWM2M_OBJ(3, 0, 5), device_factory_default_cb);
	lwm2m_set_res_buf(&LWM2M_OBJ(3, 0, 9), &bat_level, sizeof(bat_level), sizeof(bat_level), 0);
	lwm2m_set_res_buf(&LWM2M_OBJ(3, 0, 10), &mem_free, sizeof(mem_free), sizeof(mem_free), 0);
	lwm2m_set_res_buf(&LWM2M_OBJ(3, 0, 17), CONFIG_BOARD, sizeof(CONFIG_BOARD),
			  sizeof(CONFIG_BOARD), LWM2M_RES_DATA_FLAG_RO);
	lwm2m_set_res_buf(&LWM2M_OBJ(3, 0, 18), CLIENT_HW_VER, sizeof(CLIENT_HW_VER),
			  sizeof(CLIENT_HW_VER), LWM2M_RES_DATA_FLAG_RO);
	lwm2m_set_res_buf(&LWM2M_OBJ(3, 0, 20), &bat_status, sizeof(bat_status),
			  sizeof(bat_status), 0);
	lwm2m_set_res_buf(&LWM2M_OBJ(3, 0, 21), &mem_total, sizeof(mem_total),
			  sizeof(mem_total), 0);

	/* add power source resource instances */
	lwm2m_create_res_inst(&LWM2M_OBJ(3, 0, 6, 0));
	lwm2m_set_res_buf(&LWM2M_OBJ(3, 0, 6, 0), &bat_idx, sizeof(bat_idx), sizeof(bat_idx), 0);
	lwm2m_create_res_inst(&LWM2M_OBJ(3, 0, 7, 0));
	lwm2m_set_res_buf(&LWM2M_OBJ(3, 0, 7, 0), &bat_mv, sizeof(bat_mv), sizeof(bat_mv), 0);
	lwm2m_create_res_inst(&LWM2M_OBJ(3, 0, 8, 0));
	lwm2m_set_res_buf(&LWM2M_OBJ(3, 0, 8, 0), &bat_ma, sizeof(bat_ma), sizeof(bat_ma), 0);
	lwm2m_create_res_inst(&LWM2M_OBJ(3, 0, 6, 1));
	lwm2m_set_res_buf(&LWM2M_OBJ(3, 0, 6, 1), &usb_idx, sizeof(usb_idx), sizeof(usb_idx), 0);
	lwm2m_create_res_inst(&LWM2M_OBJ(3, 0, 7, 1));
	lwm2m_set_res_buf(&LWM2M_OBJ(3, 0, 7, 1), &usb_mv, sizeof(usb_mv), sizeof(usb_mv), 0);
	lwm2m_create_res_inst(&LWM2M_OBJ(3, 0, 8, 1));
	lwm2m_set_res_buf(&LWM2M_OBJ(3, 0, 8, 1), &usb_ma, sizeof(usb_ma), sizeof(usb_ma), 0);

	/* setup FIRMWARE object */
	if (IS_ENABLED(CONFIG_LWM2M_FIRMWARE_UPDATE_OBJ_SUPPORT)) {
		init_firmware_update();
	}

	/* setup TEMP SENSOR object */
	init_temp_sensor();

	/* Set multiple TEMP SENSOR resource values in one function call. */
	int err = lwm2m_set_bulk(temp_sensor_items, ARRAY_SIZE(temp_sensor_items));

	if (err) {
		LOG_ERR("Failed to set TEMP SENSOR resources");
		return err;
	}

	/* IPSO: Light Control object */
	init_led_device();

	/* IPSO: Timer object */
	init_timer_object();

	return 0;
}

static void rd_client_event(struct lwm2m_ctx *client,
			    enum lwm2m_rd_client_event client_event)
{
	switch (client_event) {

	case LWM2M_RD_CLIENT_EVENT_NONE:
		/* do nothing */
		break;

	case LWM2M_RD_CLIENT_EVENT_SERVER_DISABLED:
		LOG_DBG("LwM2M server disabled");
		break;

	case LWM2M_RD_CLIENT_EVENT_BOOTSTRAP_REG_FAILURE:
		LOG_DBG("Bootstrap registration failure!");
		break;

	case LWM2M_RD_CLIENT_EVENT_BOOTSTRAP_REG_COMPLETE:
		LOG_DBG("Bootstrap registration complete");
		break;

	case LWM2M_RD_CLIENT_EVENT_BOOTSTRAP_TRANSFER_COMPLETE:
		LOG_DBG("Bootstrap transfer complete");
		break;

	case LWM2M_RD_CLIENT_EVENT_REGISTRATION_FAILURE:
		LOG_DBG("Registration failure!");
		break;

	case LWM2M_RD_CLIENT_EVENT_REGISTRATION_COMPLETE:
		LOG_DBG("Registration complete");
		break;

	case LWM2M_RD_CLIENT_EVENT_REG_TIMEOUT:
		LOG_DBG("Registration timeout!");
		break;

	case LWM2M_RD_CLIENT_EVENT_REG_UPDATE_COMPLETE:
		LOG_DBG("Registration update complete");
		break;

	case LWM2M_RD_CLIENT_EVENT_DEREGISTER_FAILURE:
		LOG_DBG("Deregister failure!");
		break;

	case LWM2M_RD_CLIENT_EVENT_DISCONNECT:
		LOG_DBG("Disconnected");
		break;

	case LWM2M_RD_CLIENT_EVENT_QUEUE_MODE_RX_OFF:
		LOG_DBG("Queue mode RX window closed");
		break;

	case LWM2M_RD_CLIENT_EVENT_ENGINE_SUSPENDED:
		LOG_DBG("LwM2M engine suspended");
		break;

	case LWM2M_RD_CLIENT_EVENT_NETWORK_ERROR:
		LOG_ERR("LwM2M engine reported a network error.");
		lwm2m_rd_client_stop(client, rd_client_event, true);
		break;

	case LWM2M_RD_CLIENT_EVENT_REG_UPDATE:
		LOG_DBG("Registration update");
		break;
	case LWM2M_RD_CLIENT_EVENT_DEREGISTER:
		LOG_DBG("Client De-register");
		break;
	}
}

static void socket_state(int fd, enum lwm2m_socket_states state)
{
	(void) fd;
	switch (state) {
	case LWM2M_SOCKET_STATE_ONGOING:
		LOG_DBG("LWM2M_SOCKET_STATE_ONGOING");
		break;
	case LWM2M_SOCKET_STATE_ONE_RESPONSE:
		LOG_DBG("LWM2M_SOCKET_STATE_ONE_RESPONSE");
		break;
	case LWM2M_SOCKET_STATE_LAST:
		LOG_DBG("LWM2M_SOCKET_STATE_LAST");
		break;
	case LWM2M_SOCKET_STATE_NO_DATA:
		LOG_DBG("LWM2M_SOCKET_STATE_NO_DATA");
		break;
	}
}

static void observe_cb(enum lwm2m_observe_event event,
		       struct lwm2m_obj_path *path, void *user_data)
{
	char buf[LWM2M_MAX_PATH_STR_SIZE];

	switch (event) {

	case LWM2M_OBSERVE_EVENT_OBSERVER_ADDED:
		LOG_INF("Observer added for %s", lwm2m_path_log_buf(buf, path));
		break;

	case LWM2M_OBSERVE_EVENT_OBSERVER_REMOVED:
		LOG_INF("Observer removed for %s", lwm2m_path_log_buf(buf, path));
		break;

	case LWM2M_OBSERVE_EVENT_NOTIFY_ACK:
		LOG_INF("Notify acknowledged for %s", lwm2m_path_log_buf(buf, path));
		break;

	case LWM2M_OBSERVE_EVENT_NOTIFY_TIMEOUT:
		LOG_INF("Notify timeout for %s, trying registration update",
			lwm2m_path_log_buf(buf, path));

		lwm2m_rd_client_update();
		break;
	}
}

static void on_net_event_l4_disconnected(void)
{
	LOG_INF("Disconnected from network");
	lwm2m_engine_pause();
}

static void on_net_event_l4_connected(void)
{
	LOG_INF("Connected to network");
	k_sem_give(&network_connected_sem);
	lwm2m_engine_resume();
}

static void l4_event_handler(struct net_mgmt_event_callback *cb,
			     uint32_t event,
			     struct net_if *iface)
{
	switch (event) {
	case NET_EVENT_L4_CONNECTED:
		LOG_INF("IP Up");
		on_net_event_l4_connected();
		break;
	case NET_EVENT_L4_DISCONNECTED:
		LOG_INF("IP down");
		on_net_event_l4_disconnected();
		break;
	default:
		break;
	}
}

static void connectivity_event_handler(struct net_mgmt_event_callback *cb,
				       uint32_t event,
				       struct net_if *iface)
{
	if (event == NET_EVENT_CONN_IF_FATAL_ERROR) {
		LOG_ERR("Fatal error received from the connectivity layer");
		return;
	}
}

#if defined(CONFIG_WIFI)
/*
 * This Zephyr version has no persistent Wi-Fi credentials subsystem, so the
 * "wifi connect" shell command has to be retyped after every reset. Baking
 * SSID/PSK into the firmware here lets the board reconnect on its own at
 * boot instead - a PoC convenience, not a secure secret-storage mechanism
 * (see notas_estagio.md for the trade-off).
 */
static int wifi_auto_connect(struct net_if *iface)
{
	if (sizeof(CONFIG_APP_WIFI_SSID) <= 1) {
		return -ENOENT;
	}

	struct wifi_connect_req_params params = {
		.ssid = CONFIG_APP_WIFI_SSID,
		.ssid_length = sizeof(CONFIG_APP_WIFI_SSID) - 1,
		.psk = CONFIG_APP_WIFI_PSK,
		.psk_length = sizeof(CONFIG_APP_WIFI_PSK) - 1,
		.security = WIFI_SECURITY_TYPE_PSK,
		.band = WIFI_FREQ_BAND_UNKNOWN,
		.channel = WIFI_CHANNEL_ANY,
		.timeout = SYS_FOREVER_MS,
	};

	LOG_INF("Auto-connecting to Wi-Fi SSID '%s'", CONFIG_APP_WIFI_SSID);

	return net_mgmt(NET_REQUEST_WIFI_CONNECT, iface, &params, sizeof(params));
}
#endif /* CONFIG_WIFI */

int main(void)
{
	uint32_t flags = IS_ENABLED(CONFIG_LWM2M_RD_CLIENT_SUPPORT_BOOTSTRAP) ?
				LWM2M_RD_CLIENT_FLAG_BOOTSTRAP : 0;
	int ret;
	bool wait_for_network = false;

	LOG_INF(APP_BANNER " v2-ota-test");

	k_sem_init(&quit_lock, 0, K_SEM_MAX_LIMIT);

	if (IS_ENABLED(CONFIG_NET_CONNECTION_MANAGER)) {
		/* Setup handler for Zephyr NET Connection Manager events. */
		net_mgmt_init_event_callback(&l4_cb, l4_event_handler, L4_EVENT_MASK);
		net_mgmt_add_event_callback(&l4_cb);

		/* Setup handler for Zephyr NET Connection Manager Connectivity layer. */
		net_mgmt_init_event_callback(&conn_cb, connectivity_event_handler,
					     CONN_LAYER_EVENT_MASK);
		net_mgmt_add_event_callback(&conn_cb);

		ret = net_if_up(net_if_get_default());

		if (ret < 0 && ret != -EALREADY) {
			LOG_ERR("net_if_up, error: %d", ret);
			return ret;
		}

#if defined(CONFIG_WIFI)
		/* Plain Wi-Fi STA has no built-in connectivity implementation, so
		 * conn_mgr_if_connect() below returns an error and skips waiting
		 * (by design, for interfaces that don't require connectivity).
		 * Issue the Wi-Fi connect ourselves so there's something to wait
		 * for instead of racing the LwM2M registration against a network
		 * that isn't up yet.
		 */
		ret = wifi_auto_connect(net_if_get_default());
		if (ret == 0) {
			wait_for_network = true;
		} else if (ret != -ENOENT) {
			LOG_ERR("Wi-Fi auto-connect request failed: %d", ret);
		}
#endif

		ret = conn_mgr_if_connect(net_if_get_default());
		/* Ignore errors from interfaces not requiring connectivity */
		if (ret == 0) {
			wait_for_network = true;
		}

		if (wait_for_network) {
			LOG_INF("Connecting to network");
			k_sem_take(&network_connected_sem, K_FOREVER);
		}
	}

	ret = lwm2m_setup();
	if (ret < 0) {
		LOG_ERR("Cannot setup LWM2M fields (%d)", ret);
		return 0;
	}

	(void)memset(&client_ctx, 0x0, sizeof(client_ctx));
#if defined(CONFIG_LWM2M_DTLS_SUPPORT)
	client_ctx.tls_tag = CONFIG_LWM2M_APP_TLS_TAG;
#endif
	client_ctx.set_socket_state = socket_state;

	/* client_ctx.sec_obj_inst is 0 as a starting point */
	lwm2m_rd_client_start(&client_ctx, endpoint, flags, rd_client_event, observe_cb);

	k_sem_take(&quit_lock, K_FOREVER);
	return 0;
}
```

## src/modules.h
```c
/*
 * Origem: exemplo oficial do Zephyr (samples/net/lwm2m_client/src/modules.h),
 * não modificado nesta colaboração.
 *
 * Copyright (c) 2022 Nordic Semiconductor
 *
 * SPDX-License-Identifier: Apache-2.0
 */

#ifndef _MODULES_H
#define _MODULES_H

int init_led_device(void);
void init_timer_object(void);
void init_temp_sensor(void);
void init_firmware_update(void);

#endif
```

## src/temperature.c
```c
/*
 * Origem: exemplo oficial do Zephyr
 * (samples/net/lwm2m_client/src/temperature.c), não modificado nesta
 * colaboração.
 *
 * Copyright (c) 2022 Nordic Semiconductor
 *
 * SPDX-License-Identifier: Apache-2.0
 */

#define LOG_MODULE_NAME app_temp
#include <zephyr/logging/log.h>
LOG_MODULE_REGISTER(LOG_MODULE_NAME);

#include "modules.h"

#include <zephyr/drivers/hwinfo.h>
#include <zephyr/drivers/sensor.h>
#include <zephyr/net/lwm2m.h>
#include <zephyr/kernel.h>
#include <zephyr/random/random.h>
#include <stdint.h>

static struct k_work_delayable temp_work;
#define PERIOD K_MINUTES(2)

static void temp_work_cb(struct k_work *work)
{
	double v;

	if (IS_ENABLED(CONFIG_FXOS8700_TEMP)) {
		const struct device *dev = device_get_binding("nxp_fxos8700");
		struct sensor_value val;

		if (!dev) {
			LOG_ERR("device not ready.");
			goto out;
		}
		if (sensor_sample_fetch(dev)) {
			LOG_ERR("temperature data update failed");
			goto out;
		}

		sensor_channel_get(dev, SENSOR_CHAN_DIE_TEMP, &val);

		v = sensor_value_to_double(&val);
	} else {
		/* Generate dummy temperature data */
		v = 20.0 + (double)sys_rand32_get() / UINT32_MAX * 5.0;
	}

	lwm2m_set_f64(&LWM2M_OBJ(3303, 0, 5700), v);

out:
	k_work_schedule(&temp_work, PERIOD);
}

void init_temp_sensor(void)
{
	if (lwm2m_create_object_inst(&LWM2M_OBJ(3303, 0)) == 0) {
		k_work_init_delayable(&temp_work, temp_work_cb);
		k_work_schedule(&temp_work, K_NO_WAIT);
	}
}
```

## src/timer.c
```c
/*
 * Origem: exemplo oficial do Zephyr (samples/net/lwm2m_client/src/timer.c),
 * não modificado nesta colaboração.
 *
 * Copyright (c) 2022 Nordic Semiconductor
 *
 * SPDX-License-Identifier: Apache-2.0
 */

#define LOG_MODULE_NAME app_timer
#include <zephyr/logging/log.h>
LOG_MODULE_REGISTER(LOG_MODULE_NAME);

#include "modules.h"

#include <zephyr/net/lwm2m.h>

#define TIMER_NAME "Test timer"

/* An example data validation callback. */
static int timer_on_off_validate_cb(uint16_t obj_inst_id, uint16_t res_id, uint16_t res_inst_id,
				    uint8_t *data, uint16_t data_len, bool last_block,
				    size_t total_size, size_t offset)
{
	LOG_INF("Validating On/Off data");

	if (data_len != 1) {
		return -EINVAL;
	}

	if (*data > 1) {
		return -EINVAL;
	}

	return 0;
}

static int timer_digital_state_cb(uint16_t obj_inst_id, uint16_t res_id, uint16_t res_inst_id,
				  uint8_t *data, uint16_t data_len, bool last_block,
				  size_t total_size, size_t offset)
{
	bool *digital_state = (bool *)data;

	if (*digital_state) {
		LOG_INF("TIMER: ON");
	} else {
		LOG_INF("TIMER: OFF");
	}

	return 0;
}

void init_timer_object(void)
{
	lwm2m_create_object_inst(&LWM2M_OBJ(3340, 0));
	lwm2m_register_validate_callback(&LWM2M_OBJ(3340, 0, 5850), timer_on_off_validate_cb);
	lwm2m_register_post_write_callback(&LWM2M_OBJ(3340, 0, 5543), timer_digital_state_cb);
	lwm2m_set_res_buf(&LWM2M_OBJ(3340, 0, 5750), TIMER_NAME, sizeof(TIMER_NAME),
			  sizeof(TIMER_NAME), LWM2M_RES_DATA_FLAG_RO);
}
```
