## CMakeLists.txt
```
# SPDX-License-Identifier: Apache-2.0

cmake_minimum_required(VERSION 3.20.0)
find_package(Zephyr REQUIRED HINTS $ENV{ZEPHYR_BASE})
project(zephyr_thingsboard)

target_sources(app PRIVATE
    src/main.c
    src/thingsboard_mqtt.c
)
```

## Kconfig
```
# Private config options for the Zephyr + ThingsBoard PoC

mainmenu "Zephyr ThingsBoard MQTT client"

if WIFI
config APP_WIFI_SSID
	string "Wi-Fi SSID to auto-connect to at boot"
	default ""

config APP_WIFI_PSK
	string "Wi-Fi password (WPA2-PSK) for APP_WIFI_SSID"
	default ""
endif # WIFI

config TB_BROKER_HOSTNAME
	string "ThingsBoard MQTT broker hostname"
	default "mqtt.eu.thingsboard.cloud"

config TB_BROKER_PORT
	string "ThingsBoard MQTT broker port (mqtts/TLS)"
	default "8883"

config TB_PROVISION_KEY
	string "ThingsBoard provision device key"
	default "CHANGE_ME_PROVISION_KEY"
	help
	  Shared across every device of this Device Profile - not a
	  per-device secret (same mechanism/value as esp-idf-thingsboard).

config TB_PROVISION_SECRET
	string "ThingsBoard provision device secret"
	default "CHANGE_ME_PROVISION_SECRET"

source "Kconfig.zephyr"
```

## prj.conf
```kconfig
# Zephyr + ThingsBoard PoC: native Zephyr MQTT client (subsys/net/lib/mqtt)
# talking directly to the same ThingsBoard Cloud account/device profile as
# esp-idf-thingsboard/, over MQTTS (TLS), with device provisioning,
# telemetry and RPC (getStatus/reboot) - the representative subset of what
# was validated on ESP-IDF (secção 5 do relatório).

CONFIG_NETWORKING=y
CONFIG_NET_LOG=y
CONFIG_LOG=y

CONFIG_NET_IPV4=y
CONFIG_NET_TCP=y
CONFIG_NET_SOCKETS=y
CONFIG_NET_SOCKETS_SOCKOPT_TLS=y
CONFIG_POSIX_API=y

# DNS to resolve CONFIG_TB_BROKER_HOSTNAME (mqtt.eu.thingsboard.cloud).
CONFIG_DNS_RESOLVER=y

# Native MQTT client + TLS transport.
CONFIG_MQTT_LIB=y
CONFIG_MQTT_LIB_TLS=y

# mbedTLS for the MQTTS handshake (server-cert verification only, no
# mutual TLS - ThingsBoard authenticates via MQTT username = access token,
# same scheme as esp-idf-thingsboard).
CONFIG_MBEDTLS=y
CONFIG_MBEDTLS_BUILTIN=y
CONFIG_MBEDTLS_ENABLE_HEAP=y
CONFIG_MBEDTLS_HEAP_SIZE=40000
# Default (16384, the RFC max fragment size) allocates static in+out TLS
# record buffers far bigger than our small JSON payloads ever need - this
# was the main cause of a ~13KB dram0_0_seg overflow on first build.
CONFIG_MBEDTLS_SSL_MAX_CONTENT_LEN=4096
CONFIG_MBEDTLS_PEM_CERTIFICATE_FORMAT=y
CONFIG_MBEDTLS_SERVER_NAME_INDICATION=y

# The ThingsBoard Cloud cert chain (Sectigo/USERTrust ECC) is fully EC-based
# (P-256 and P-384 keys, ECDSA signatures) - none of this is enabled by
# Zephyr's default mbedTLS config (confirmed by the first flash attempt: CA
# parse failed with MBEDTLS_ERR_X509_UNKNOWN_SIG_ALG + OID_NOT_FOUND,
# -0x262e, because CONFIG_MBEDTLS_ECP_C itself was not set).
CONFIG_MBEDTLS_ECP_C=y
CONFIG_MBEDTLS_ECDH_C=y
CONFIG_MBEDTLS_ECDSA_C=y
CONFIG_MBEDTLS_KEY_EXCHANGE_ECDHE_ECDSA_ENABLED=y
CONFIG_MBEDTLS_ECP_DP_SECP256R1_ENABLED=y
CONFIG_MBEDTLS_ECP_DP_SECP384R1_ENABLED=y

# The cert chain's signatures are SHA-384-based (ecdsa-with-SHA384,
# sha384WithRSAEncryption) - SHA-384 is not in Zephyr's default hash set
# either (same class of gap as the EC curves above).
CONFIG_MBEDTLS_SHA384=y

CONFIG_NET_BUF_RX_COUNT=16
CONFIG_NET_BUF_TX_COUNT=16
CONFIG_NET_PKT_RX_COUNT=16
CONFIG_NET_PKT_TX_COUNT=16

CONFIG_MAIN_STACK_SIZE=4096
CONFIG_SYSTEM_WORKQUEUE_STACK_SIZE=2048
CONFIG_HEAP_MEM_POOL_SIZE=16384

# For sys_reboot() in the RPC "reboot" method handler.
CONFIG_REBOOT=y
```

## overlay-tb.conf
```kconfig
# Real ThingsBoard device-profile provisioning credentials (same account/
# profile as esp-idf-thingsboard/ - shared across every device of this
# profile, not a per-device secret, see Kconfig help text).
CONFIG_TB_PROVISION_KEY="CHANGE_ME_PROVISION_KEY"
CONFIG_TB_PROVISION_SECRET="CHANGE_ME_PROVISION_SECRET"
```

## overlay-wifi.conf
```kconfig
# Same pattern as winegrid/lwm2m/overlay-wifi.conf: credentials baked into
# the firmware image (PoC convenience, not secure storage - see
# notas_estagio.md), auto-connect at boot handled in main.c.
CONFIG_WIFI=y
CONFIG_NET_L2_ETHERNET=y
CONFIG_NET_L2_WIFI_SHELL=y
CONFIG_NET_SHELL=y
CONFIG_SHELL=y
CONFIG_NET_CONNECTION_MANAGER=y

CONFIG_APP_WIFI_SSID="CHANGE_ME_SSID"
CONFIG_APP_WIFI_PSK="CHANGE_ME_PASSWORD"

CONFIG_NET_CONFIG_SETTINGS=n
CONFIG_NET_DHCPV4=y
CONFIG_ESP32_WIFI_STA_AUTO_DHCPV4=y

# Only IPv4 needed to reach ThingsBoard Cloud - same rationale as lwm2m/.
CONFIG_NET_IPV6=n
```

## esp32_wifi.overlay
```dts
/*
 * Copyright (c) 2022 Espressif Systems (Shanghai) Co., Ltd.
 *
 * SPDX-License-Identifier: Apache-2.0
 */

&wifi {
	status = "okay";
};
```

## src/main.c
```c
/*
 * Origem: escrito de raiz nesta colaboração (Claude), não copiado de
 * nenhum repositório - o padrão de ligação Wi-Fi replica (não copia) o já
 * usado em lwm2m/src/lwm2m-client.c, esse sim baseado num exemplo oficial.
 *
 * Zephyr + ThingsBoard PoC - Wi-Fi auto-connect (same pattern as
 * winegrid/lwm2m/src/lwm2m-client.c) followed by the ThingsBoard MQTT flow.
 *
 * SPDX-License-Identifier: Apache-2.0
 */

#define LOG_MODULE_NAME zephyr_thingsboard
#define LOG_LEVEL LOG_LEVEL_INF

#include <zephyr/logging/log.h>
LOG_MODULE_REGISTER(LOG_MODULE_NAME);

#include <zephyr/kernel.h>
#include <zephyr/net/conn_mgr_monitor.h>
#include <zephyr/net/conn_mgr_connectivity.h>
#if defined(CONFIG_WIFI)
#include <zephyr/net/wifi_mgmt.h>
#endif

#include "thingsboard_mqtt.h"

#define L4_EVENT_MASK (NET_EVENT_L4_CONNECTED | NET_EVENT_L4_DISCONNECTED)
#define CONN_LAYER_EVENT_MASK (NET_EVENT_CONN_IF_FATAL_ERROR)

static struct net_mgmt_event_callback l4_cb;
static struct net_mgmt_event_callback conn_cb;
static K_SEM_DEFINE(network_connected_sem, 0, 1);

static void l4_event_handler(struct net_mgmt_event_callback *cb, uint32_t event,
			      struct net_if *iface)
{
	if (event == NET_EVENT_L4_CONNECTED) {
		LOG_INF("IP Up");
		k_sem_give(&network_connected_sem);
	} else if (event == NET_EVENT_L4_DISCONNECTED) {
		LOG_INF("IP down");
	}
}

static void connectivity_event_handler(struct net_mgmt_event_callback *cb, uint32_t event,
					struct net_if *iface)
{
	if (event == NET_EVENT_CONN_IF_FATAL_ERROR) {
		LOG_ERR("Fatal error received from the connectivity layer");
	}
}

#if defined(CONFIG_WIFI)
static int wifi_auto_connect(struct net_if *iface)
{
	if (sizeof(CONFIG_APP_WIFI_SSID) <= 1) {
		return -ENOENT;
	}

	struct wifi_connect_req_params params = {
		.ssid = CONFIG_APP_WIFI_SSID,
		.ssid_length = sizeof(CONFIG_APP_WIFI_SSID) - 1,
		.psk = CONFIG_APP_WIFI_PSK,
		.psk_length = sizeof(CONFIG_APP_WIFI_PSK) - 1,
		.security = WIFI_SECURITY_TYPE_PSK,
		.band = WIFI_FREQ_BAND_UNKNOWN,
		.channel = WIFI_CHANNEL_ANY,
		.timeout = SYS_FOREVER_MS,
	};

	LOG_INF("Auto-connecting to Wi-Fi SSID '%s'", CONFIG_APP_WIFI_SSID);
	return net_mgmt(NET_REQUEST_WIFI_CONNECT, iface, &params, sizeof(params));
}
#endif /* CONFIG_WIFI */

int main(void)
{
	bool wait_for_network = false;
	int ret;

	LOG_INF("Zephyr + ThingsBoard PoC");

	net_mgmt_init_event_callback(&l4_cb, l4_event_handler, L4_EVENT_MASK);
	net_mgmt_add_event_callback(&l4_cb);
	net_mgmt_init_event_callback(&conn_cb, connectivity_event_handler, CONN_LAYER_EVENT_MASK);
	net_mgmt_add_event_callback(&conn_cb);

	ret = net_if_up(net_if_get_default());
	if (ret < 0 && ret != -EALREADY) {
		LOG_ERR("net_if_up, error: %d", ret);
		return ret;
	}

#if defined(CONFIG_WIFI)
	ret = wifi_auto_connect(net_if_get_default());
	if (ret == 0) {
		wait_for_network = true;
	} else if (ret != -ENOENT) {
		LOG_ERR("Wi-Fi auto-connect request failed: %d", ret);
	}
#endif

	ret = conn_mgr_if_connect(net_if_get_default());
	if (ret == 0) {
		wait_for_network = true;
	}

	if (wait_for_network) {
		LOG_INF("Connecting to network");
		k_sem_take(&network_connected_sem, K_FOREVER);
	}

	thingsboard_run();

	LOG_ERR("thingsboard_run() returned - should never happen");
	return 0;
}
```

## src/ca_cert.h
```c
/*
 * Origem: o certificado em si não foi "escrito" por ninguém - é a chave
 * pública real da autoridade certificadora (Sectigo/USERTrust), extraída
 * do servidor com o comando abaixo. O C que o envolve (nome da variável,
 * formato do array) foi escrito nesta colaboração (Claude).
 *
 * Root CA for mqtt.eu.thingsboard.cloud (Sectigo/USERTrust chain).
 * Fetched 2026-07-24 via: openssl s_client -connect mqtt.eu.thingsboard.cloud:8883 -showcerts
 * This is the last (root) cert the server sends in its chain.
 *
 * SPDX-License-Identifier: Apache-2.0
 */
#ifndef TB_CA_CERT_H__
#define TB_CA_CERT_H__

static const unsigned char tb_ca_certificate[] =
"-----BEGIN CERTIFICATE-----\r\n"
"MIID0zCCArugAwIBAgIQVmcdBOpPmUxvEIFHWdJ1lDANBgkqhkiG9w0BAQwFADB7\r\n"
"MQswCQYDVQQGEwJHQjEbMBkGA1UECAwSR3JlYXRlciBNYW5jaGVzdGVyMRAwDgYD\r\n"
"VQQHDAdTYWxmb3JkMRowGAYDVQQKDBFDb21vZG8gQ0EgTGltaXRlZDEhMB8GA1UE\r\n"
"AwwYQUFBIENlcnRpZmljYXRlIFNlcnZpY2VzMB4XDTE5MDMxMjAwMDAwMFoXDTI4\r\n"
"MTIzMTIzNTk1OVowgYgxCzAJBgNVBAYTAlVTMRMwEQYDVQQIEwpOZXcgSmVyc2V5\r\n"
"MRQwEgYDVQQHEwtKZXJzZXkgQ2l0eTEeMBwGA1UEChMVVGhlIFVTRVJUUlVTVCBO\r\n"
"ZXR3b3JrMS4wLAYDVQQDEyVVU0VSVHJ1c3QgRUNDIENlcnRpZmljYXRpb24gQXV0\r\n"
"aG9yaXR5MHYwEAYHKoZIzj0CAQYFK4EEACIDYgAEGqxUWqn5aCPnetUkb1PGWthL\r\n"
"q8bVttHmc3Gu3ZzWDGH926CJA7gFFOxXzu5dP+Ihs8731Ip54KODfi2X0GHE8Znc\r\n"
"JZFjq38wo7Rw4sehM5zzvy5cU7Ffs30yf4o043l5o4HyMIHvMB8GA1UdIwQYMBaA\r\n"
"FKARCiM+lvEH7OKvKe+CpX/QMKS0MB0GA1UdDgQWBBQ64QmG1M8ZwpZ2dEl23OA1\r\n"
"xmNjmjAOBgNVHQ8BAf8EBAMCAYYwDwYDVR0TAQH/BAUwAwEB/zARBgNVHSAECjAI\r\n"
"MAYGBFUdIAAwQwYDVR0fBDwwOjA4oDagNIYyaHR0cDovL2NybC5jb21vZG9jYS5j\r\n"
"b20vQUFBQ2VydGlmaWNhdGVTZXJ2aWNlcy5jcmwwNAYIKwYBBQUHAQEEKDAmMCQG\r\n"
"CCsGAQUFBzABhhhodHRwOi8vb2NzcC5jb21vZG9jYS5jb20wDQYJKoZIhvcNAQEM\r\n"
"BQADggEBABns652JLCALBIAdGN5CmXKZFjK9Dpx1WywV4ilAbe7/ctvbq5AfjJXy\r\n"
"ij0IckKJUAfiORVsAYfZFhr1wHUrxeZWEQff2Ji8fJ8ZOd+LygBkc7xGEJuTI42+\r\n"
"FsMuCIKchjN0djsoTI0DQoWz4rIjQtUfenVqGtF8qmchxDM6OW1TyaLtYiKou+JV\r\n"
"bJlsQ2uRl9EMC5MCHdK8aXdJ5htN978UeAOwproLtOGFfy/cQjutdAFI3tZs4RmY\r\n"
"CV4Ks2dH/hzg1cEo70qLRDEmBDeNiXQ2Lu+lIg+DdEmSx/cQwgwp+7e9un/jX9Wf\r\n"
"8qn0dNW44bOwgeThpWOjzOoEeJBuv/c=\r\n"
"-----END CERTIFICATE-----\r\n";

#endif /* TB_CA_CERT_H__ */
```

## src/thingsboard_mqtt.c
```c
/*
 * Origem: escrito de raiz nesta colaboração (Claude), não copiado de
 * nenhum repositório - a convenção de tópicos/payloads do ThingsBoard
 * replica (não copia) a mesma lógica já usada em
 * esp-idf-thingsboard/main/app_main.c.
 *
 * Zephyr + ThingsBoard PoC: native Zephyr MQTT client (subsys/net/lib/mqtt)
 * talking to the same ThingsBoard Cloud account/device profile validated
 * on ESP-IDF (esp-idf-thingsboard/main/app_main.c) - device provisioning,
 * telemetry, and RPC (getStatus/reboot). Unlike ESP RainMaker, ThingsBoard
 * is not tied to a firmware SDK: it only needs an MQTT client speaking its
 * topic/payload convention, which is exactly what this file provides.
 *
 * SPDX-License-Identifier: Apache-2.0
 */

#include <zephyr/kernel.h>
#include <zephyr/net/socket.h>
#include <zephyr/net/mqtt.h>
#include <zephyr/net/tls_credentials.h>
#include <zephyr/net/net_if.h>
#include <zephyr/sys/reboot.h>
#include <zephyr/logging/log.h>
#include <string.h>
#include <stdio.h>

#include "thingsboard_mqtt.h"
#include "ca_cert.h"

LOG_MODULE_REGISTER(tb_mqtt, LOG_LEVEL_INF);

#define TB_PROVISION_TOPIC_REQUEST  "/provision/request"
#define TB_PROVISION_TOPIC_RESPONSE "/provision/response"
#define TB_TELEMETRY_TOPIC          "v1/devices/me/telemetry"
#define TB_RPC_REQUEST_TOPIC_FILTER "v1/devices/me/rpc/request/+"
#define TB_RPC_REQUEST_TOPIC_PREFIX "v1/devices/me/rpc/request/"

#define TB_CA_CERT_TAG 1

#define RX_BUF_SIZE 1024
#define TX_BUF_SIZE 1024
#define PAYLOAD_BUF_SIZE 512

static uint8_t rx_buffer[RX_BUF_SIZE];
static uint8_t tx_buffer[TX_BUF_SIZE];
static uint8_t payload_buf[PAYLOAD_BUF_SIZE];

static struct sockaddr_storage broker_addr;
static struct pollfd fds[1];

static const sec_tag_t sec_tags[] = { TB_CA_CERT_TAG };

/* client_configure() is only ever used sequentially (provisioning fully
 * disconnects before the main-phase client connects), so one static
 * mqtt_utf8 - whose lifetime must outlive the function that sets it, unlike
 * a stack compound literal - is safely reused for both. */
static struct mqtt_utf8 s_username;

static int s_fake_temperature = 20;

static int tls_init(void)
{
	int err = tls_credential_add(TB_CA_CERT_TAG, TLS_CREDENTIAL_CA_CERTIFICATE,
				      tb_ca_certificate, sizeof(tb_ca_certificate));
	if (err < 0) {
		LOG_ERR("Failed to register CA certificate: %d", err);
	}
	return err;
}

static int resolve_broker(void)
{
	struct addrinfo *result;
	struct addrinfo hints = {
		.ai_family = AF_INET,
		.ai_socktype = SOCK_STREAM,
	};

	int err = getaddrinfo(CONFIG_TB_BROKER_HOSTNAME, CONFIG_TB_BROKER_PORT, &hints, &result);
	if (err != 0 || result == NULL) {
		LOG_ERR("Failed to resolve %s: %d", CONFIG_TB_BROKER_HOSTNAME, err);
		return -EIO;
	}

	memset(&broker_addr, 0, sizeof(broker_addr));
	struct sockaddr_in *broker4 = (struct sockaddr_in *)&broker_addr;

	broker4->sin_family = AF_INET;
	broker4->sin_addr.s_addr = ((struct sockaddr_in *)result->ai_addr)->sin_addr.s_addr;
	broker4->sin_port = ((struct sockaddr_in *)result->ai_addr)->sin_port;
	freeaddrinfo(result);

	LOG_INF("Resolved %s", CONFIG_TB_BROKER_HOSTNAME);
	return 0;
}

static void get_device_name(char *out, size_t out_size)
{
	struct net_linkaddr *link_addr = net_if_get_link_addr(net_if_get_default());

	if (link_addr != NULL && link_addr->len == 6) {
		snprintf(out, out_size, "zephyr-%02x%02x%02x%02x%02x%02x",
			 link_addr->addr[0], link_addr->addr[1], link_addr->addr[2],
			 link_addr->addr[3], link_addr->addr[4], link_addr->addr[5]);
	} else {
		snprintf(out, out_size, "zephyr-unknown");
	}
}

/* Small ad hoc JSON string-value extractor for the two flat, known-shape
 * responses this file needs to parse ({"status":..,"credentialsValue":..}
 * and {"method":..}) - avoids pulling in Zephyr's schema-based JSON library
 * for what is otherwise a couple of fixed lookups. */
static bool json_extract_string(const char *json, size_t json_len, const char *key, char *out,
				 size_t out_size)
{
	char pattern[40];
	int pattern_len = snprintf(pattern, sizeof(pattern), "\"%s\":\"", key);

	if (pattern_len <= 0 || (size_t)pattern_len >= json_len) {
		return false;
	}

	for (size_t i = 0; i + (size_t)pattern_len < json_len; i++) {
		if (memcmp(json + i, pattern, pattern_len) == 0) {
			size_t start = i + pattern_len;
			size_t end = start;

			while (end < json_len && json[end] != '"') {
				end++;
			}
			size_t len = end - start;

			if (len >= out_size) {
				len = out_size - 1;
			}
			memcpy(out, json + start, len);
			out[len] = '\0';
			return true;
		}
	}
	return false;
}

static void client_configure(struct mqtt_client *client, const char *username)
{
	mqtt_client_init(client);

	client->broker = &broker_addr;
	client->client_id.utf8 = (uint8_t *)"zephyr-tb-client";
	client->client_id.size = strlen("zephyr-tb-client");
	client->password = NULL;
	s_username.utf8 = (uint8_t *)username;
	s_username.size = strlen(username);
	client->user_name = &s_username;
	client->protocol_version = MQTT_VERSION_3_1_1;
	client->rx_buf = rx_buffer;
	client->rx_buf_size = sizeof(rx_buffer);
	client->tx_buf = tx_buffer;
	client->tx_buf_size = sizeof(tx_buffer);

	client->transport.type = MQTT_TRANSPORT_SECURE;
	struct mqtt_sec_config *tls_config = &client->transport.tls.config;

	tls_config->peer_verify = TLS_PEER_VERIFY_REQUIRED;
	tls_config->cipher_list = NULL;
	tls_config->sec_tag_list = sec_tags;
	tls_config->sec_tag_count = ARRAY_SIZE(sec_tags);
	tls_config->hostname = CONFIG_TB_BROKER_HOSTNAME;
}

static int mqtt_socket_fd(struct mqtt_client *client)
{
	return client->transport.tls.sock;
}

static int wait_socket(struct mqtt_client *client, int timeout_ms)
{
	fds[0].fd = mqtt_socket_fd(client);
	fds[0].events = POLLIN;
	return poll(fds, 1, timeout_ms);
}

/* --- Provisioning phase --- */

static bool s_provisioning_done;
static char s_provisioned_token[64];

static void provisioning_evt_handler(struct mqtt_client *client, const struct mqtt_evt *evt)
{
	switch (evt->type) {
	case MQTT_EVT_CONNACK: {
		if (evt->result != 0) {
			LOG_ERR("Provisioning CONNACK error: %d", evt->result);
			s_provisioning_done = true;
			break;
		}
		LOG_INF("Provisioning: connected, requesting credentials");

		struct mqtt_topic sub_topic = {
			.topic = { .utf8 = (uint8_t *)TB_PROVISION_TOPIC_RESPONSE,
				   .size = strlen(TB_PROVISION_TOPIC_RESPONSE) },
			.qos = MQTT_QOS_1_AT_LEAST_ONCE,
		};
		struct mqtt_subscription_list sub_list = {
			.list = &sub_topic, .list_count = 1, .message_id = 1
		};
		mqtt_subscribe(client, &sub_list);

		char device_name[48];
		get_device_name(device_name, sizeof(device_name));

		char payload[256];
		int len = snprintf(payload, sizeof(payload),
				    "{\"deviceName\":\"%s\",\"provisionDeviceKey\":\"%s\","
				    "\"provisionDeviceSecret\":\"%s\"}",
				    device_name, CONFIG_TB_PROVISION_KEY, CONFIG_TB_PROVISION_SECRET);

		struct mqtt_publish_param pub = {
			.message.topic.topic.utf8 = (uint8_t *)TB_PROVISION_TOPIC_REQUEST,
			.message.topic.topic.size = strlen(TB_PROVISION_TOPIC_REQUEST),
			.message.topic.qos = MQTT_QOS_1_AT_LEAST_ONCE,
			.message.payload.data = (uint8_t *)payload,
			.message.payload.len = len,
			.message_id = 2,
		};
		mqtt_publish(client, &pub);
		break;
	}
	case MQTT_EVT_PUBLISH: {
		const struct mqtt_publish_param *pub = &evt->param.publish;
		uint32_t len = pub->message.payload.len;

		if (len > sizeof(payload_buf) - 1) {
			len = sizeof(payload_buf) - 1;
		}
		mqtt_read_publish_payload(client, payload_buf, len);
		payload_buf[len] = '\0';

		char status[32];

		if (json_extract_string((char *)payload_buf, len, "status", status, sizeof(status)) &&
		    strcmp(status, "SUCCESS") == 0 &&
		    json_extract_string((char *)payload_buf, len, "credentialsValue",
					 s_provisioned_token, sizeof(s_provisioned_token))) {
			LOG_INF("Provisioning succeeded, token issued");
		} else {
			LOG_ERR("Provisioning failed: %s", payload_buf);
		}
		s_provisioning_done = true;
		break;
	}
	case MQTT_EVT_DISCONNECT:
		LOG_INF("Provisioning: disconnected");
		break;
	default:
		break;
	}
}

static bool run_provisioning(char *out_token, size_t out_size)
{
	static struct mqtt_client client;

	client_configure(&client, "provision");
	client.evt_cb = provisioning_evt_handler;

	int err = mqtt_connect(&client);
	if (err != 0) {
		LOG_ERR("Provisioning mqtt_connect failed: %d", err);
		return false;
	}

	s_provisioning_done = false;
	int64_t deadline = k_uptime_get() + 15000;

	while (!s_provisioning_done && k_uptime_get() < deadline) {
		if (wait_socket(&client, 500) > 0) {
			mqtt_input(&client);
		}
		mqtt_live(&client);
	}

	mqtt_disconnect(&client);

	if (!s_provisioning_done || strlen(s_provisioned_token) == 0) {
		LOG_ERR("Provisioning timed out");
		return false;
	}

	strncpy(out_token, s_provisioned_token, out_size - 1);
	out_token[out_size - 1] = '\0';
	return true;
}

/* --- Main phase: telemetry + RPC --- */

static struct mqtt_client s_client;

static void handle_rpc_request(const char *topic, size_t topic_len, const char *data, size_t data_len)
{
	char response_topic[64];
	const char *request_id = topic + strlen(TB_RPC_REQUEST_TOPIC_PREFIX);
	int request_id_len = (int)topic_len - (int)strlen(TB_RPC_REQUEST_TOPIC_PREFIX);

	snprintf(response_topic, sizeof(response_topic), "v1/devices/me/rpc/response/%.*s",
		 request_id_len, request_id);

	char method[32];

	if (!json_extract_string(data, data_len, "method", method, sizeof(method))) {
		return;
	}

	LOG_INF("RPC request: method=%s", method);

	char resp_payload[128];
	int resp_len;

	if (strcmp(method, "getStatus") == 0) {
		resp_len = snprintf(resp_payload, sizeof(resp_payload),
				     "{\"temperature\":%d,\"uptimeMs\":%lld}",
				     s_fake_temperature, k_uptime_get());
	} else if (strcmp(method, "reboot") == 0) {
		resp_len = snprintf(resp_payload, sizeof(resp_payload), "{\"result\":\"rebooting\"}");
	} else {
		resp_len = snprintf(resp_payload, sizeof(resp_payload), "{\"error\":\"unknown method\"}");
	}

	struct mqtt_publish_param pub = {
		.message.topic.topic.utf8 = (uint8_t *)response_topic,
		.message.topic.topic.size = strlen(response_topic),
		.message.topic.qos = MQTT_QOS_1_AT_LEAST_ONCE,
		.message.payload.data = (uint8_t *)resp_payload,
		.message.payload.len = resp_len,
		.message_id = 100,
	};
	mqtt_publish(&s_client, &pub);

	if (strcmp(method, "reboot") == 0) {
		k_sleep(K_MSEC(500));
		sys_reboot(SYS_REBOOT_WARM);
	}
}

static void main_evt_handler(struct mqtt_client *client, const struct mqtt_evt *evt)
{
	switch (evt->type) {
	case MQTT_EVT_CONNACK:
		if (evt->result != 0) {
			LOG_ERR("CONNACK error: %d", evt->result);
			break;
		}
		LOG_INF("Connected to ThingsBoard");

		struct mqtt_topic sub_topic = {
			.topic = { .utf8 = (uint8_t *)TB_RPC_REQUEST_TOPIC_FILTER,
				   .size = strlen(TB_RPC_REQUEST_TOPIC_FILTER) },
			.qos = MQTT_QOS_1_AT_LEAST_ONCE,
		};
		struct mqtt_subscription_list sub_list = {
			.list = &sub_topic, .list_count = 1, .message_id = 1
		};
		mqtt_subscribe(client, &sub_list);
		break;

	case MQTT_EVT_PUBLISH: {
		const struct mqtt_publish_param *pub = &evt->param.publish;
		uint32_t len = pub->message.payload.len;
		const char *topic = (char *)pub->message.topic.topic.utf8;
		size_t topic_len = pub->message.topic.topic.size;

		if (len > sizeof(payload_buf) - 1) {
			len = sizeof(payload_buf) - 1;
		}
		mqtt_read_publish_payload(client, payload_buf, len);
		payload_buf[len] = '\0';

		if (topic_len >= strlen(TB_RPC_REQUEST_TOPIC_PREFIX) &&
		    strncmp(topic, TB_RPC_REQUEST_TOPIC_PREFIX, strlen(TB_RPC_REQUEST_TOPIC_PREFIX)) == 0) {
			handle_rpc_request(topic, topic_len, (char *)payload_buf, len);
		}
		break;
	}

	case MQTT_EVT_DISCONNECT:
		LOG_INF("Disconnected from ThingsBoard");
		break;

	default:
		break;
	}
}

static void publish_telemetry(struct mqtt_client *client)
{
	s_fake_temperature = 20 + (s_fake_temperature + 1 - 20) % 10;

	char payload[64];
	int len = snprintf(payload, sizeof(payload), "{\"temperature\":%d}", s_fake_temperature);

	struct mqtt_publish_param pub = {
		.message.topic.topic.utf8 = (uint8_t *)TB_TELEMETRY_TOPIC,
		.message.topic.topic.size = strlen(TB_TELEMETRY_TOPIC),
		.message.topic.qos = MQTT_QOS_1_AT_LEAST_ONCE,
		.message.payload.data = (uint8_t *)payload,
		.message.payload.len = len,
		.message_id = 3,
	};
	int err = mqtt_publish(client, &pub);

	if (err == 0) {
		LOG_INF("Telemetry published: %s", payload);
	} else {
		LOG_ERR("Telemetry publish failed: %d", err);
	}
}

void thingsboard_run(void)
{
	if (tls_init() < 0) {
		return;
	}
	if (resolve_broker() < 0) {
		return;
	}

	char access_token[64];

	LOG_INF("Starting device provisioning");
	if (!run_provisioning(access_token, sizeof(access_token))) {
		LOG_ERR("Provisioning failed, aborting");
		return;
	}

	client_configure(&s_client, access_token);
	s_client.evt_cb = main_evt_handler;

	int err = mqtt_connect(&s_client);
	if (err != 0) {
		LOG_ERR("mqtt_connect failed: %d", err);
		return;
	}

	int64_t next_telemetry = k_uptime_get();

	while (true) {
		if (wait_socket(&s_client, 1000) > 0) {
			mqtt_input(&s_client);
		}
		mqtt_live(&s_client);

		if (k_uptime_get() >= next_telemetry) {
			publish_telemetry(&s_client);
			next_telemetry = k_uptime_get() + 10000;
		}
	}
}
```

## src/thingsboard_mqtt.h
```c
#pragma once

/* Origem: escrito de raiz nesta colaboração (Claude), não copiado de
 * nenhum repositório.
 *
 * Full ThingsBoard MQTT flow over the native Zephyr MQTT client: device
 * provisioning (if no token stored yet) -> connect with the issued access
 * token -> periodic telemetry -> RPC (getStatus/reboot). Blocks forever;
 * call once Wi-Fi/IP is up. Mirrors esp-idf-thingsboard/main/app_main.c. */
void thingsboard_run(void);
```
