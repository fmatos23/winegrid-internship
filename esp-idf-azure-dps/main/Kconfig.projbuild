## esp-idf-azure-dps/main/Kconfig.projbuild
```kconfig
menu "Azure IoT DPS Configuration"

    config AZURE_DPS_ID_SCOPE
        string "DPS ID Scope"
        default "CHANGE_ME_ID_SCOPE"
        help
            From the DPS instance's Overview page in the Azure Portal
            (watgrid-dps -> Overview -> ID Scope).

    config AZURE_DPS_REGISTRATION_ID
        string "DPS Registration ID"
        default "esp32-winegrid"
        help
            Must match the Registration ID configured on an Individual
            Enrollment in the DPS instance (Settings -> Manage enrollments) -
            or, in Group Enrollment mode, is simply this device's chosen
            unique identity within the group (any string, not pre-registered
            anywhere in advance).

    config AZURE_DPS_USE_GROUP_ENROLLMENT
        bool "Use Group Enrollment (derive per-device key from a shared group key)"
        default n
        help
            Off (default): AZURE_DPS_SYMMETRIC_KEY below is used directly as
            this device's own key, matching an Individual Enrollment.
            On: AZURE_DPS_SYMMETRIC_KEY is instead treated as the *group's*
            key (from a Group Enrollment), and this device derives its own
            key locally as HMAC-SHA256(groupKey, AZURE_DPS_REGISTRATION_ID) -
            the same derivation Azure performs server-side to verify it,
            without ever needing a per-device credential provisioned in
            advance. Lets many devices of the same model share one secret,
            each proving a distinct identity.

    config AZURE_DPS_SYMMETRIC_KEY
        string "DPS Symmetric Key (base64) - individual device key, or group key if AZURE_DPS_USE_GROUP_ENROLLMENT is on"
        default "CHANGE_ME_PRIMARY_KEY"
        help
            Primary Key shown on the Individual/Group Enrollment after
            creating it. Used locally to sign SAS tokens (HMAC-SHA256) -
            never sent over the network as-is. Treat as a secret: only ever
            stored in sdkconfig (gitignored), never hardcoded in source.

endmenu
```

## esp-idf-thingsboard/main/Kconfig.projbuild
```kconfig
menu "Example Configuration"

    config BROKER_URL
        string "Broker URL"
        default "mqtt://mqtt.eclipseprojects.io"
        help
            URL of the broker to connect to

    config BROKER_URL_FROM_STDIN
        bool
        default y if BROKER_URL = "FROM_STDIN"

    config TB_PROVISION_KEY
        string "ThingsBoard provision device key"
        default "CHANGE_ME_PROVISION_KEY"
        help
            Shared across every device of this Device Profile (Profiles ->
            Device profiles -> <profile> -> Device provisioning). Not a
            per-device secret - it just lets a factory-fresh board register
            itself and receive its own real access token automatically.

    config TB_PROVISION_SECRET
        string "ThingsBoard provision device secret"
        default "CHANGE_ME_PROVISION_SECRET"

endmenu
```

## zephyr-mcp3221-poc/module/drivers/sensor/mcp3221/Kconfig
```kconfig
# Copyright (c) 2026 Francisco Matos
# SPDX-License-Identifier: Apache-2.0

config MCP3221
	bool "Microchip MCP3221 I2C ADC"
	default y
	depends on DT_HAS_MICROCHIP_MCP3221_ENABLED
	select I2C
	help
	  Enable the out-of-tree driver for the Microchip MCP3221
	  single-channel 12-bit I2C ADC. There is no in-tree Zephyr
	  driver for this chip.
```

## zephyr-mcp3221-poc/module/dts/bindings/sensor/microchip,mcp3221.yaml
```yaml
description: |
  Microchip MCP3221 single-channel 12-bit I2C ADC.

  The MCP3221 has no configuration registers: a plain I2C read of 2 bytes
  returns the latest 12-bit conversion result (the top 4 bits of the first
  byte are always 0). The I2C address is fixed in silicon per part suffix
  (e.g. 0x4D for the MCP3221A5T-E/OT variant) and must match the physical
  part used.

compatible: "microchip,mcp3221"

include: ["i2c-device.yaml", "sensor-device.yaml"]

properties:
  vref-millivolts:
    type: int
    default: 3300
    description: |
      Reference voltage (in mV) used to convert the raw 12-bit reading into
      a voltage. The MCP3221 has no internal reference - Vref equals Vdd.
      Defaults to 3300 mV, matching the ESP32's 3.3V supply.
```

## zephyr-rn2483-poc/module/drivers/lora/rn2483/Kconfig
```kconfig
# Copyright (c) 2026 Francisco Matos
# SPDX-License-Identifier: Apache-2.0

config LORA_RN2483
	bool "Microchip RN2483 LoRa module (AT-style UART commands)"
	default y
	depends on DT_HAS_MICROCHIP_RN2483_ENABLED
	select LORA
	help
	  Out-of-tree driver for the Microchip RN2483 LoRa/LoRaWAN module.
	  There is no in-tree Zephyr driver for this exact module (only for
	  bare Semtech transceivers, or Reyax's AT-command modules via
	  drivers/lora/rylrxxx.c).
```

## zephyr-rn2483-poc/module/dts/bindings/lora/microchip,rn2483.yaml
```yaml
description: |
  Microchip RN2483 LoRa/LoRaWAN module with AT-style, plain-text command
  interface over UART (57600 8N1). Unlike bare Semtech transceivers
  (SX126x/SX127x, natively supported by Zephyr's drivers/lora/), this module
  has its own onboard MCU/radio and is controlled entirely through text
  commands - not SPI registers. No in-tree Zephyr driver exists for it.

compatible: "microchip,rn2483"

include: uart-device.yaml
```
